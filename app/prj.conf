## CMakeLists.txt
```
# SPDX-License-Identifier: Apache-2.0

cmake_minimum_required(VERSION 3.13.1)
find_package(Zephyr REQUIRED HINTS $ENV{ZEPHYR_BASE})
project(NONE)

if (NOT DEFINED FROM_WHO)
  set(FROM_WHO Zephyr)
endif()

target_compile_definitions(app PRIVATE "-DMCUBOOT_BLINKY2_FROM=\"${FROM_WHO}\"")

target_sources(app PRIVATE src/main.c)

set(CMAKE_EXPORT_COMPILE_COMMANDS ON)
```

## west.yml
```
manifest:
  self:
    path: app

  defaults:
    remote: zephyr-upstream
  
  remotes:
    - name: zephyr-upstream
      url-base: https://github.com/zephyrproject-rtos

  projects:
    - name: zephyr
      west-commands: scripts/west-commands.yml
      revision: v3.2.0
      import:
        name-allowlist:
          - cmsis
          - hal_nordic
          - segger
          - mbedtls
          - mcuboot
```

## prj.conf
```kconfig
# Print a banner on the UART on startup.
CONFIG_BOOT_BANNER=y

CONFIG_REBOOT=y

# Enable console and printk()
CONFIG_PRINTK=y
CONFIG_STDOUT_CONSOLE=y

CONFIG_GPIO=y

CONFIG_BOOTLOADER_MCUBOOT=y
CONFIG_MCUBOOT_SIGNATURE_KEY_FILE="bootloader/mcuboot/root-rsa-2048.pem"
CONFIG_IMG_MANAGER=y
CONFIG_MCUBOOT_IMG_MANAGER=y

# Logging
CONFIG_LOG=y
CONFIG_USE_SEGGER_RTT=y
CONFIG_RTT_CONSOLE=y
CONFIG_CONSOLE=y

# Flash
CONFIG_FLASH=y
CONFIG_FLASH_PAGE_LAYOUT=y
CONFIG_MPU_ALLOW_FLASH_WRITE=y
CONFIG_SOC_FLASH_NRF_EMULATE_ONE_BYTE_WRITE_ACCESS=y

CONFIG_HEAP_MEM_POOL_SIZE=4096
CONFIG_MAIN_STACK_SIZE=2048

CONFIG_DFU_BSDIFF=y
```

## src/main.c
```c
/*
 * Copyright (c) 2016 Intel Corporation
 *
 * SPDX-License-Identifier: Apache-2.0
 */

#include <zephyr/kernel.h>
#include <zephyr/sys/util.h>
#include <zephyr/sys/printk.h>
#include <zephyr/drivers/gpio.h>
#include "delta.h"

/* BUTTON */
#define SW0_NODE	DT_ALIAS(sw0)
#if !DT_NODE_HAS_STATUS(SW0_NODE, okay)
#error "Unsupported board: sw0 devicetree alias is not defined"
#endif
static const struct gpio_dt_spec button = GPIO_DT_SPEC_GET_OR(SW0_NODE, gpios,
							      {0});

static struct gpio_callback button_cb_data;
static bool btn_flag;

/* LED */
#define SLEEP_TIME_MS   1000 /*BLINKING SPEED*/

#define LED0_NODE DT_ALIAS(led0)

/*
 * A build error on this line means your board is unsupported.
 * See the sample documentation for information on how to fix this.
 */
static const struct gpio_dt_spec led = GPIO_DT_SPEC_GET(LED0_NODE, gpios);

static const struct device *flash_device =
	DEVICE_DT_GET_OR_NULL(DT_CHOSEN(zephyr_flash_controller));

/* Debug printouts (adds about 800 B to img)
 * Define to 0 to disable
 */
#ifndef PRINT_ERRORS
	#define PRINT_ERRORS 1
#endif

/*Initiating button and led*/
static int config_devices(void);

/*Responds to button 1 being pressed*/
void button_pressed(const struct device *dev,
					struct gpio_callback *cb,
					uint32_t pins);

/* MAIN FUNCTION */
void main(void)
{
	struct flash_mem *flash_pt;
	int ret;

	flash_pt = k_malloc(sizeof(struct flash_mem));
	flash_pt->device = flash_device;

	if (!flash_pt->device) {
		return;
	}
	if (config_devices()) {
		return;
	}

	/*Main loop*/
	while (1) {
		/* turn light on/off */
		ret = gpio_pin_toggle_dt(&led);
		if (ret < 0) {
			return;
		}
		k_msleep(SLEEP_TIME_MS);

		if (btn_flag) {
			ret = delta_check_and_apply(flash_pt);
			if (ret) {
				#if PRINT_ERRORS == 1
				printk("%s", delta_error_as_string(ret));
				#endif
				return;
			}
			btn_flag = false;
		}
	}
}

static int config_devices(void)
{
	int ret;

	/* setup led */
	if (!gpio_is_ready_dt(&led)) {
		return -1;
	}

	ret = gpio_pin_configure_dt(&led, GPIO_OUTPUT_ACTIVE);
	if (ret < 0) {
		return -1;
	}

	/*setup button*/
	if (!gpio_is_ready_dt(&button)) {
		return -1;
	}

	ret = gpio_pin_configure_dt(&button, GPIO_INPUT);
	if (ret) {
		return -1;
	}

	ret = gpio_pin_interrupt_configure_dt(&button,
					      GPIO_INT_EDGE_TO_ACTIVE);
	if (ret) {
		return -1;
	}

	gpio_init_callback(&button_cb_data, button_pressed, BIT(button.pin));
	gpio_add_callback(button.port, &button_cb_data);

	btn_flag = false;

	return 0;
}

void button_pressed(const struct device *dev, struct gpio_callback *cb,
		    uint32_t pins)
{
	printk("Button pressed at %" PRIu32 "\n", k_cycle_get_32());
	btn_flag = true;
}
```

## src/apply_patch.c
```c
/**
 * BSD 2-Clause License
 *
 * Copyright (c) 2019, Erik Moqvist
 * All rights reserved.
 *
 * Redistribution and use in source and binary forms, with or without
 * modification, are permitted provided that the following conditions
 * are met:
 *
 * * Redistributions of source code must retain the above copyright
 *   notice, this list of conditions and the following disclaimer.
 *
 * * Redistributions in binary form must reproduce the above copyright
 *   notice, this list of conditions and the following disclaimer in
 *   the documentation and/or other materials provided with the
 *   distribution.
 *
 * THIS SOFTWARE IS PROVIDED BY THE COPYRIGHT HOLDERS AND CONTRIBUTORS
 * "AS IS" AND ANY EXPRESS OR IMPLIED WARRANTIES, INCLUDING, BUT NOT
 * LIMITED TO, THE IMPLIED WARRANTIES OF MERCHANTABILITY AND FITNESS
 * FOR A PARTICULAR PURPOSE ARE DISCLAIMED. IN NO EVENT SHALL THE
 * COPYRIGHT HOLDER OR CONTRIBUTORS BE LIABLE FOR ANY DIRECT,
 * INDIRECT, INCIDENTAL, SPECIAL, EXEMPLARY, OR CONSEQUENTIAL DAMAGES
 * (INCLUDING, BUT NOT LIMITED TO, PROCUREMENT OF SUBSTITUTE GOODS OR
 * SERVICES; LOSS OF USE, DATA, OR PROFITS; OR BUSINESS INTERRUPTION)
 * HOWEVER CAUSED AND ON ANY THEORY OF LIABILITY, WHETHER IN CONTRACT,
 * STRICT LIABILITY, OR TORT (INCLUDING NEGLIGENCE OR OTHERWISE)
 * ARISING IN ANY WAY OUT OF THE USE OF THIS SOFTWARE, EVEN IF ADVISED
 * OF THE POSSIBILITY OF SUCH DAMAGE.
 */

#include <stdlib.h>
#include "detools.h"

static void print_usage_and_exit(const char *name_p)
{
    printf("Usage: %s {apply_patch, apply_patch_in_place}\n", name_p);
    exit(1);
}

static void print_apply_patch_usage_and_exit(const char *name_p)
{
    printf("Usage: %s apply_patch <from-file> <patch-file> <to-file>\n",
           name_p);
    exit(1);
}

int main(int argc, const char *argv[])
{
    int res;

    if (argc < 2) {
        print_usage_and_exit(argv[0]);
    }

    if (strcmp("apply_patch", argv[1]) == 0) {
        if (argc != 5) {
            print_apply_patch_usage_and_exit(argv[0]);
        }

        res = detools_apply_patch_filenames(argv[2], argv[3], argv[4]);
    } else {
        print_usage_and_exit(argv[0]);
    }

    if (res > 0) {
        res = 0;
    } else if (res < 0) {
        res *= -1;

        printf("error: %s (error code %d)\n",
               detools_error_as_string(res),
               res);
    }

    return (res);
}
```

## src/detools.h
```c
/**
 * BSD 2-Clause License
 *
 * Copyright (c) 2019-2020, Erik Moqvist
 * All rights reserved.
 *
 * Redistribution and use in source and binary forms, with or without
 * modification, are permitted provided that the following conditions are met:
 *
 * * Redistributions of source code must retain the above copyright notice, this
 *   list of conditions and the following disclaimer.
 *
 * * Redistributions in binary form must reproduce the above copyright notice,
 *   this list of conditions and the following disclaimer in the documentation
 *   and/or other materials provided with the distribution.
 *
 * THIS SOFTWARE IS PROVIDED BY THE COPYRIGHT HOLDERS AND CONTRIBUTORS "AS IS"
 * AND ANY EXPRESS OR IMPLIED WARRANTIES, INCLUDING, BUT NOT LIMITED TO, THE
 * IMPLIED WARRANTIES OF MERCHANTABILITY AND FITNESS FOR A PARTICULAR PURPOSE ARE
 * DISCLAIMED. IN NO EVENT SHALL THE COPYRIGHT HOLDER OR CONTRIBUTORS BE LIABLE
 * FOR ANY DIRECT, INDIRECT, INCIDENTAL, SPECIAL, EXEMPLARY, OR CONSEQUENTIAL
 * DAMAGES (INCLUDING, BUT NOT LIMITED TO, PROCUREMENT OF SUBSTITUTE GOODS OR
 * SERVICES; LOSS OF USE, DATA, OR PROFITS; OR BUSINESS INTERRUPTION) HOWEVER
 * CAUSED AND ON ANY THEORY OF LIABILITY, WHETHER IN CONTRACT, STRICT LIABILITY,
 * OR TORT (INCLUDING NEGLIGENCE OR OTHERWISE) ARISING IN ANY WAY OUT OF THE USE
 * OF THIS SOFTWARE, EVEN IF ADVISED OF THE POSSIBILITY OF SUCH DAMAGE.
 */

#ifndef DETOOLS_H
#define DETOOLS_H

/*
 * Configuration.
 *
 * Define any of the defines below to 0 to disable given feature.
 */

#ifndef DETOOLS_CONFIG_FILE_IO
#    define DETOOLS_CONFIG_FILE_IO                 1
#endif

#ifndef DETOOLS_CONFIG_COMPRESSION_HEATSHRINK
#    define DETOOLS_CONFIG_COMPRESSION_HEATSHRINK  1
#endif

#include <stdint.h>
#include <string.h>
#include <stdio.h>
#include <stdbool.h>

#define DETOOLS_VERSION                  "0.47.0"

/* Error codes. */
#define DETOOLS_OK                                        0
#define DETOOLS_NOT_IMPLEMENTED                           1
#define DETOOLS_NOT_DONE                                  2
#define DETOOLS_BAD_PATCH_TYPE                            3
#define DETOOLS_BAD_COMPRESSION                           4
#define DETOOLS_INTERNAL_ERROR                            5
#define DETOOLS_OUT_OF_MEMORY                             8
#define DETOOLS_CORRUPT_PATCH                             9
#define DETOOLS_IO_FAILED                                10
#define DETOOLS_ALREADY_DONE                             11
#define DETOOLS_FILE_OPEN_FAILED                         12
#define DETOOLS_FILE_CLOSE_FAILED                        13
#define DETOOLS_FILE_READ_FAILED                         14
#define DETOOLS_FILE_WRITE_FAILED                        15
#define DETOOLS_FILE_SEEK_FAILED                         16
#define DETOOLS_FILE_TELL_FAILED                         17
#define DETOOLS_SHORT_HEADER                             18
#define DETOOLS_NOT_ENOUGH_PATCH_DATA                    19
#define DETOOLS_HEATSHRINK_SINK                          20
#define DETOOLS_HEATSHRINK_POLL                          21
#define DETOOLS_STEP_SET_FAILED                          22
#define DETOOLS_STEP_GET_FAILED                          23
#define DETOOLS_ALREADY_FAILED                           24
#define DETOOLS_CORRUPT_PATCH_OVERFLOW                   25
#define DETOOLS_HEATSHRINK_HEADER                        27

/**
 * Read callback.
 *
 * @param[in] arg_p User data passed to detools_apply_patch_init().
 * @param[out] buf_p Buffer to read into.
 * @param[in] size Number of bytes to read.
 *
 * @return zero(0) or negative error code.
 */
typedef int (*detools_read_t)(void *arg_p, uint8_t *buf_p, size_t size);

/**
 * Write callback.
 *
 * @param[in] arg_p User data passed to detools_apply_patch_init().
 * @param[in] buf_p Buffer to write.
 * @param[in] size Number of bytes to write.
 *
 * @return zero(0) or negative error code.
 */
typedef int (*detools_write_t)(void *arg_p, const uint8_t *buf_p, size_t size);

/**
 * Seek from current position callback.
 *
 * @param[in] arg_p User data passed to detools_apply_patch_init().
 * @param[in] offset Offset to seek to from current position.
 *
 * @return zero(0) or negative error code.
 */
typedef int (*detools_seek_t)(void *arg_p, int offset);

/**
 * Memory read callback.
 *
 * @param[in] arg_p User data passed to detools_apply_patch_init().
 * @param[out] dst_p Buffer to read into.
 * @param[in] src Address to read from.
 * @param[in] size Number of bytes to read.
 *
 * @return zero(0) or negative error code.
 */
typedef int (*detools_mem_read_t)(void *arg_p,
                                  void *dst_p,
                                  uintptr_t src,
                                  size_t size);

/**
 * Memory write callback.
 *
 * @param[in] arg_p User data passed to detools_apply_patch_init().
 * @param[in] dst Address to write to.
 * @param[in] addr src_p Buffer to write from.
 * @param[in] size Number of bytes to write.
 *
 * @return zero(0) or negative error code.
 */
typedef int (*detools_mem_write_t)(void *arg_p,
                                   uintptr_t dst,
                                   void *src_p,
                                   size_t size);

/**
 * Memory erase callback.
 *
 * @param[in] arg_p User data passed to detools_apply_patch_init().
 * @param[in] addr Address to erase from.
 * @param[in] size Number of bytes to erase.
 *
 * @return zero(0) or negative error code.
 */
typedef int (*detools_mem_erase_t)(void *arg_p, uintptr_t addr, size_t size);

/**
 * State read callback.
 *
 * @param[in] arg_p User data passed to detools_apply_patch_init().
 * @param[out] buf_p Buffer to read into.
 * @param[in] size Number of bytes to read.
 *
 * @return zero(0) or negative error code.
 */
typedef int (*detools_state_read_t)(void *arg_p, void *buf_p, size_t size);

/**
 * State write callback.
 *
 * @param[in] arg_p User data passed to detools_apply_patch_init().
 * @param[in] buf_p Buffer to write.
 * @param[in] size Number of bytes to write.
 *
 * @return zero(0) or negative error code.
 */
typedef int (*detools_state_write_t)(void *arg_p, const void *buf_p, size_t size);

/**
 * Step set callback.
 *
 * @param[in] arg_p User data passed to detools_apply_patch_init().
 * @param[in] step Step to set. Later read by the step get callback.
 *
 * @return zero(0) or negative error code.
 */
typedef int (*detools_step_set_t)(void *arg_p, int step);

/**
 * Step get callback.
 *
 * @param[in] arg_p User data passed to detools_apply_patch_init().
 * @param[out] step_p Outputs the most recently set step by the set
 *                    callback, or zero(0) if not yet set.
 *
 * @return zero(0) or negative error code.
 */
typedef int (*detools_step_get_t)(void *arg_p, int *step_p);

#if DETOOLS_CONFIG_COMPRESSION_HEATSHRINK == 1

#include "heatshrink/heatshrink_decoder.h"

struct detools_apply_patch_patch_reader_heatshrink_t {
    int8_t window_sz2;
    int8_t lookahead_sz2;
    heatshrink_decoder decoder;
};

#endif

enum detools_unpack_usize_state_t {
    detools_unpack_usize_state_first_t = 0,
    detools_unpack_usize_state_consecutive_t
};

struct detools_unpack_usize_t {
    enum detools_unpack_usize_state_t state;
    int value;
    int offset;
};

enum detools_crle_state_t {
    detools_crle_state_idle_t = 0,
    detools_crle_state_scattered_size_t,
    detools_crle_state_scattered_data_t,
    detools_crle_state_repeated_repetitions_t,
    detools_crle_state_repeated_data_t,
    detools_crle_state_repeated_data_read_t
};

struct detools_apply_patch_patch_reader_crle_t {
    enum detools_crle_state_t state;
    union {
        struct {
            size_t number_of_bytes_left;
            struct detools_unpack_usize_t size;
        } scattered;
        struct {
            uint8_t value;
            size_t number_of_bytes_left;
            struct detools_unpack_usize_t size;
        } repeated;
    } kind;
};

struct detools_apply_patch_patch_reader_t {
    struct detools_apply_patch_chunk_t *patch_chunk_p;
    struct {
        int state;
        int value;
        int offset;
        bool is_signed;
    } size;
    union {
        struct detools_apply_patch_patch_reader_heatshrink_t heatshrink;
    } compression;
    int (*destroy)(struct detools_apply_patch_patch_reader_t *self_p);
    int (*decompress)(struct detools_apply_patch_patch_reader_t *self_p,
                      uint8_t *buf_p,
                      size_t *size_p);
};

struct detools_apply_patch_chunk_t {
    const uint8_t *buf_p;
    size_t size;
    size_t offset;
};

enum detools_apply_patch_state_t {
    detools_apply_patch_state_init_t = 0,
    detools_apply_patch_state_dfpatch_size_t,
    detools_apply_patch_state_diff_size_t,
    detools_apply_patch_state_diff_data_t,
    detools_apply_patch_state_extra_size_t,
    detools_apply_patch_state_extra_data_t,
    detools_apply_patch_state_adjustment_t,
    detools_apply_patch_state_done_t,
    detools_apply_patch_state_failed_t
};

/**
 * The apply patch data structure.
 */
struct detools_apply_patch_t {
    detools_read_t from_read;
    detools_seek_t from_seek;
    size_t patch_size;
    detools_write_t to_write;
    void *arg_p;
    enum detools_apply_patch_state_t state;
    int compression;
    size_t patch_offset;
    size_t to_offset;
    size_t to_size;
    int from_offset;
    size_t chunk_size;
    struct detools_apply_patch_patch_reader_t patch_reader;
    struct detools_apply_patch_chunk_t chunk;
};

/**
 * Initialize given apply patch object.
 *
 * @param[out] self_p Apply patch object to initialize.
 * @param[in] from_read Callback to read from-data.
 * @param[in] from_seek Callback to seek from current position in from-data.
 * @param[in] patch_size Patch size in bytes. Not used if
 *                       `detools_apply_patch_restore()` is called
 *                       immediately after this function.
 * @param[in] to_write Destination callback.
 * @param[in] arg_p Argument passed to the callbacks.
 *
 * @return zero(0) or negative error code.
 */
int detools_apply_patch_init(struct detools_apply_patch_t *self_p,
                             detools_read_t from_read,
                             detools_seek_t from_seek,
                             size_t patch_size,
                             detools_write_t to_write,
                             void *arg_p);

/**
 * Dump given apply patch object state. Call
 * `detools_apply_patch_restore()` to restore an apply patch object to
 * the dumped state.
 *
 * @param[in] self_p Apply patch object to dump.
 * @param[in] write Write callback.
 *
 * @return zero(0) or negative error code.
 */
int detools_apply_patch_dump(struct detools_apply_patch_t *self_p,
                             detools_state_write_t state_write);

/**
 * Restore given apply patch object to given dumped
 * state.
 *
 * `detools_apply_patch_get_to_offset()` and
 * `detools_apply_patch_get_patch_offset()` are often called after
 * this function to restore the to and patch streams.
 *
 * @param[in,out] self_p Initialized apply patch object to restore.
 * @param[in] read Callback to read the dumped state.
 *
 * @return zero(0) or negative error code.
 */
int detools_apply_patch_restore(struct detools_apply_patch_t *self_p,
                                detools_state_read_t state_read);

/**
 * Get the current to stream offset. Often used to restore the to
 * stream after restore.
 *
 * @param[in] self_p Apply patch object.
 *
 * @return The current to stream offset.
 */
size_t detools_apply_patch_get_to_offset(struct detools_apply_patch_t *self_p);

/**
 * Get the current patch stream offset. Often used to restore the
 * patch stream after restore.
 *
 * @param[in] self_p Apply patch object.
 *
 * @return The current patch stream offset.
 */
size_t detools_apply_patch_get_patch_offset(struct detools_apply_patch_t *self_p);

/**
 * Call this function repeatedly until all patch data has been
 * processed or an error occurres. Call detools_apply_patch_finalize()
 * to finalize the patching, even if an error occurred.
 *
 * @param[in,out] self_p Initialized apply patch object.
 * @param[in] patch_p Next chunk of the patch.
 * @param[in] size Patch buffer size.
 *
 * @return zero(0) or negative error code.
 */
int detools_apply_patch_process(struct detools_apply_patch_t *self_p,
                                const uint8_t *patch_p,
                                size_t size);

/**
 * Call once after all data has been processed to finalize the
 * patching. The value returned from this function should be ignored
 * if an error occurred in detools_apply_patch_process().
 *
 * @param[in,out] self_p Initialized apply patch object.
 *
 * @return Size of to-data in bytes if the patch was applied
 *         successfully, or negative error code.
 */
int detools_apply_patch_finalize(struct detools_apply_patch_t *self_p);

/**
 * Apply given patch using read, write and seek callbacks.
 *
 * @param[in] from_read Source read callback.
 * @param[in] from_seek Source seek callback.
 * @param[in] patch_read Patch read callback.
 * @param[in] patch_size Patch size in bytes.
 * @param[in] to_write Destination write callback.
 * @param[in] arg_p Argument passed to all callbacks.
 *
 * @return Size of to-data in bytes or negative error code.
 */
int detools_apply_patch_callbacks(detools_read_t from_read,
                                  detools_seek_t from_seek,
                                  detools_read_t patch_read,
                                  size_t patch_size,
                                  detools_write_t to_write,
                                  void *arg_p);

#if DETOOLS_CONFIG_FILE_IO == 1

/**
 * Apply given patch file to given from file and write the output to
 * given to file.
 *
 * @param[in] from_p Source file name.
 * @param[in] patch_p Patch file name.
 * @param[in] to_p Destination file name.
 *
 * @return Size of to-data in bytes or negative error code.
 */
int detools_apply_patch_filenames(const char *from_p,
                                  const char *patch_p,
                                  const char *to_p);

#endif

/**
 * Get the error string for given error code.
 *
 * @param[in] Error code.
 *
 * @return Error string.
 */
const char *detools_error_as_string(int error);

#endif
```

## src/main.h
```c
#ifndef MAIN_H
#define MAIN_H

#include <zephyr.h>
#include <sys/printk.h>
#include <sys/util.h>
#include <device.h>
#include <devicetree.h>
#include <drivers/gpio.h>
#include <drivers/flash.h>
#include <inttypes.h>
#include <storage/flash_map.h>
#include <stdio.h>
#include <dfu/mcuboot.h>
#include <power/reboot.h>
#include "detools/detools.h"

/* IMAGE OFFSETS AND SIZES */
#define PRIMARY_OFFSET FLASH_AREA_OFFSET(image_0)
#define PRIMARY_SIZE FLASH_AREA_SIZE(image_0)
#define SECONDARY_OFFSET FLASH_AREA_OFFSET(image_1)
#define SECONDARY_SIZE FLASH_AREA_SIZE(image_1)
#define STORAGE_OFFSET FLASH_AREA_OFFSET(storage)
#define STORAGE_SIZE FLASH_AREA_SIZE(storage)

/* PATCH HEADER SIZE */
#define HEADER_SIZE 0x18

/* FLASH MEMORY AND POINTERS TO CURRENT LOCATION OF BUFFERS AND END OF IMAGE AREAS.
 * - "Patch" refers to the area containing the patch image. 
 * - "From" refers to the area containing the source image. 
 * - "To" refers to the area where the target image is to be placed.
 * */
struct flash_mem {
	const struct device *device;
	off_t patch_current; 
	off_t patch_end; 
	off_t from_current; 
	off_t from_end; 
	off_t to_current; 
	off_t to_end; 
};

/* BUTTON */
#define SW0_NODE	DT_ALIAS(sw0)

#if DT_NODE_HAS_STATUS(SW0_NODE, okay)
#define SW0_GPIO_LABEL	DT_GPIO_LABEL(SW0_NODE, gpios)
#define SW0_GPIO_PIN	DT_GPIO_PIN(SW0_NODE, gpios)
#define SW0_GPIO_FLAGS	(GPIO_INPUT | DT_GPIO_FLAGS(SW0_NODE, gpios))
#else
#error "Unsupported board: sw0 devicetree alias is not defined"
#define SW0_GPIO_LABEL	""
#define SW0_GPIO_PIN	0
#define SW0_GPIO_FLAGS	0
#endif

static struct gpio_callback button_cb_data;
static bool btn_flag;

/* LED */
#define SLEEP_TIME_MS   1000 //BLINKING SPEED

#define LED0_NODE DT_ALIAS(led1)
#if DT_NODE_HAS_STATUS(LED0_NODE, okay)
#define LED0	DT_GPIO_LABEL(LED0_NODE, gpios)
#define PIN	DT_GPIO_PIN(LED0_NODE, gpios)
#define FLAGS	DT_GPIO_FLAGS(LED0_NODE, gpios)
#else
/* A build error here means your board isn't set up to blink an LED. */
#error "Unsupported board: led0 devicetree alias is not defined"
#define LED0	""
#define PIN	0
#define FLAGS	0
#endif

/* FUNCTION DECLARATIONS */

/**
 * Functiong for initiating the devices used by the 
 * program. 
 *
 * @param[in] flash the flash memory. 
 * @param[in] button the button.
 * @param[in] led the led.
 *
 * @return zero(0) or error code.
 */
static int configure_devices(const struct device *flash, 
					const struct device *button, 
					const struct device *led);

/**
 * Functiong for writing to secondary partition.
 *
 * @param[in] arg_p pointer to the devices flash memory. 
 * @param[in] buf_p buffer containing information to be written.
 * @param[in] size size of the buffer.
 *
 * @return zero(0) or error code.
 */
static int du_flash_write(void *arg_p,
					const uint8_t *buf_p,
					size_t size);

/**
 * Functiong for reading from primary partition.
 *
 * @param[in] arg_p pointer to the devices flash memory. 
 * @param[in] buf_p buffer to be read into.
 * @param[in] size size of the buffer.
 *
 * @return zero(0) or error code.
 */
static int du_flash_from_read(void *arg_p,
					uint8_t *buf_p,
					size_t size);

/**
 * Functiong for reading from patch partition.
 *
 * @param[in] arg_p pointer to the devices flash memory. 
 * @param[in] buf_p buffer to be read into.
 * @param[in] size size of the buffer.
 *
 * @return zero(0) or error code.
 */
static int du_flash_patch_read(void *arg_p,
					uint8_t *buf_p,
					size_t size);

/**
 * Functiong for jumping on the primary partition
 *
 * @param[in] arg_p pointer to the devices flash memory. 
 * @param[in] offset the size of the jump forward in bytes.
 *
 * @return zero(0) or error code.
 */
static int du_flash_seek(void *arg_p,
					int offset);

/**
 * Functiong for erasing data on the entire secondary partiton.
 *
 * @param[in] flash the devices flash memory. 
 *
 * @return zero(0) or error code.
 */
static int erase_secondary(const struct device *flash);

/**
 * Functiong initiating the flash_mem struct by setting
 * all offsets to their correct adresses.
 *
 * @param[in] flash the devices flash memory. 
 *
 * @return zero(0) or error code.
 */
static int init_flash_mem(struct flash_mem *flash);

/**
 * Functiong for reading the metadata from the patch and 
 * changing the header to mark that the patch has been 
 * applied.
 *
 * @param[in] flash the devices flash memory. 
 *
 * @return zero(0) or error code.
 */
static int read_patch_header(struct flash_mem *flash);

//Responds to button 1 being pressed 
void button_pressed(const struct device *dev, 
					struct gpio_callback *cb,
		    		uint32_t pins);

#endif
```

## src/test2.c
```c
/*
 * Copyright (c) 2016 Intel Corporation
 *
 * SPDX-License-Identifier: Apache-2.0
 */

#include <zephyr.h>
#include <sys/printk.h>
#include <sys/util.h>
#include <device.h>
#include <devicetree.h>
#include <drivers/gpio.h>
#include <drivers/flash.h>
#include <inttypes.h>
#include <storage/flash_map.h>
#include <stdio.h>


/* 1000 msec = 1 sec */
#define SLEEP_TIME_MS   1000

/* The devicetree node identifier for the "led0" alias. */
#define LED0_NODE DT_ALIAS(led1)

#if DT_NODE_HAS_STATUS(LED0_NODE, okay)
#define LED0	DT_GPIO_LABEL(LED0_NODE, gpios)
#define PIN	DT_GPIO_PIN(LED0_NODE, gpios)
#define FLAGS	DT_GPIO_FLAGS(LED0_NODE, gpios)
#else
/* A build error here means your board isn't set up to blink an LED. */
#error "Unsupported board: led0 devicetree alias is not defined"
#define LED0	""
#define PIN	0
#define FLAGS	0
#endif

/*
 * Get button configuration from the devicetree sw0 alias.
 *
 * At least a GPIO device and pin number must be provided. The 'flags'
 * cell is optional.
 */

#define SW0_NODE	DT_ALIAS(sw0)

#if DT_NODE_HAS_STATUS(SW0_NODE, okay)
#define SW0_GPIO_LABEL	DT_GPIO_LABEL(SW0_NODE, gpios)
#define SW0_GPIO_PIN	DT_GPIO_PIN(SW0_NODE, gpios)
#define SW0_GPIO_FLAGS	(GPIO_INPUT | DT_GPIO_FLAGS(SW0_NODE, gpios))
#else
#error "Unsupported board: sw0 devicetree alias is not defined"
#define SW0_GPIO_LABEL	""
#define SW0_GPIO_PIN	0
#define SW0_GPIO_FLAGS	0
#endif

// STORAGE 
#define STORAGE_OFFSET FLASH_AREA_OFFSET(storage)

static struct gpio_callback button_cb_data;
static bool btn_flag; 

void button_pressed(const struct device *dev, struct gpio_callback *cb,
		    uint32_t pins);

bool configure_devices(const struct device *flash, const struct device *button, const struct device *led);


void main(void)
{
	const struct device *led,*button,*flash;
	int ret,length;
	bool led_is_on;

	led = device_get_binding(LED0);
	button = device_get_binding(SW0_GPIO_LABEL);
	flash = device_get_binding(DT_CHOSEN_ZEPHYR_FLASH_CONTROLLER_LABEL);

	length = 8;
	led_is_on = true;
	btn_flag = false; 

	unsigned char buf[length];

	if (!led||!button||!flash)
		return;

	if (!configure_devices(flash,button,led))
		return;
	
	printk("Hello World from %s on %s!\n",MCUBOOT_BLINKY2_FROM, CONFIG_BOARD);

	/*Main loop*/
	while (1) {
		gpio_pin_set(led, PIN, (int)led_is_on);
		led_is_on = !led_is_on;
		k_msleep(SLEEP_TIME_MS);

		if(btn_flag){
			// Read from memory
			if(!flash){
				return;
			}

			ret = flash_read(flash,STORAGE_OFFSET, &buf,(length+1)*sizeof(char));

			if(ret!=0){
				return;
			}

			printk("Word: %s\n",buf);

			btn_flag = false;
		}
	}
}

/*Exectues when button is pressed*/
void button_pressed(const struct device *dev, struct gpio_callback *cb,
		    uint32_t pins)
{
	printk("Button pressed at %" PRIu32 "\n", k_cycle_get_32());
	btn_flag = true;
}

bool configure_devices(const struct device *flash, const struct device *button, const struct device *led) {
	int ret; 
	ret = gpio_pin_configure(led, PIN, GPIO_OUTPUT_ACTIVE | FLAGS);
	ret |= gpio_pin_configure(button, SW0_GPIO_PIN, SW0_GPIO_FLAGS);

	if (ret!=0)
		return false;

	ret = gpio_pin_interrupt_configure(button,SW0_GPIO_PIN,GPIO_INT_EDGE_TO_ACTIVE);

	if (ret!=0)
		return false;
	
	gpio_init_callback(&button_cb_data, button_pressed, BIT(SW0_GPIO_PIN));
	gpio_add_callback(button, &button_cb_data);

	return true; 
}
```
