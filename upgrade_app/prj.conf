## CMakeLists.txt
```
# SPDX-License-Identifier: Apache-2.0

cmake_minimum_required(VERSION 3.13.1)
find_package(Zephyr REQUIRED HINTS $ENV{ZEPHYR_BASE})
project(NONE)

if (NOT DEFINED FROM_WHO)
  set(FROM_WHO Zephyr)
endif()

target_compile_definitions(app PRIVATE "-DMCUBOOT_BLINKY1_FROM=\"${FROM_WHO}\"")

target_sources(app PRIVATE src/test1.c)
```

## prj.conf
```kconfig
# Print a banner on the UART on startup.
CONFIG_BOOT_BANNER=y

# Enable console and printk()
CONFIG_PRINTK=y
CONFIG_STDOUT_CONSOLE=y

CONFIG_GPIO=y

CONFIG_BOOTLOADER_MCUBOOT=y

# Logging
CONFIG_LOG=y
CONFIG_USE_SEGGER_RTT=y
CONFIG_RTT_CONSOLE=y
CONFIG_CONSOLE=y

# Flash
CONFIG_FLASH=y
CONFIG_FLASH_PAGE_LAYOUT=y
CONFIG_MPU_ALLOW_FLASH_WRITE=y
CONFIG_SOC_FLASH_NRF_EMULATE_ONE_BYTE_WRITE_ACCESS=y

CONFIG_HEAP_MEM_POOL_SIZE=1024
CONFIG_MAIN_STACK_SIZE=2048
```

## src/main.c
```c
#include <zephyr.h>
#include <sys/util.h>
#include <sys/printk.h>
#include <drivers/gpio.h>
#include "delta/delta.h"

/* BUTTON */
#define SW0_NODE	DT_ALIAS(sw0)

#if DT_NODE_HAS_STATUS(SW0_NODE, okay)
#define SW0_GPIO_LABEL	DT_GPIO_LABEL(SW0_NODE, gpios)
#define SW0_GPIO_PIN	DT_GPIO_PIN(SW0_NODE, gpios)
#define SW0_GPIO_FLAGS	(GPIO_INPUT | DT_GPIO_FLAGS(SW0_NODE, gpios))
#else
#error "Unsupported board: sw0 devicetree alias is not defined"
#define SW0_GPIO_LABEL	""
#define SW0_GPIO_PIN	0
#define SW0_GPIO_FLAGS	0
#endif

static struct gpio_callback button_cb_data;
static bool btn_flag;

/* LED */
#define SLEEP_TIME_MS   1000 //BLINKING SPEED

#define LED0_NODE DT_ALIAS(led0)
#if DT_NODE_HAS_STATUS(LED0_NODE, okay)
#define LED0	DT_GPIO_LABEL(LED0_NODE, gpios)
#define PIN	DT_GPIO_PIN(LED0_NODE, gpios)
#define FLAGS	DT_GPIO_FLAGS(LED0_NODE, gpios)
#else
/* A build error here means your board isn't set up to blink an LED. */
#error "Unsupported board: led0 devicetree alias is not defined"
#define LED0	""
#define PIN	0
#define FLAGS	0
#endif

//Initiating button and led
static int config_devices(const struct device *button, 
					const struct device *led);

//Responds to button 1 being pressed 
void button_pressed(const struct device *dev, 
					struct gpio_callback *cb,
		    		uint32_t pins);

/* MAIN FUNCTION */
void main(void)
{
	const struct device *led,*button;
	struct flash_mem *flash_pt;
	bool led_is_on = true;
	int ret;

	led = device_get_binding(LED0);
	button = device_get_binding(SW0_GPIO_LABEL);
	flash_pt = k_malloc(sizeof(struct flash_mem));
	flash_pt->device = device_get_binding(DT_CHOSEN_ZEPHYR_FLASH_CONTROLLER_LABEL);

	if (!led||!button||!flash_pt->device)
		return;

	if (config_devices(button,led))
		return;
	
	/*Main loop*/
	while (1) 
	{
		/* turn light on/off */
		gpio_pin_set(led, PIN, (int)led_is_on);
		led_is_on = !led_is_on;
		k_msleep(SLEEP_TIME_MS);

		if(btn_flag)
		{
			ret = delta_check_and_apply(flash_pt);

			if(ret){
				printk("%s",delta_error_as_string(ret));
				return;
			}
				
			btn_flag = false;
		}
	}
}

static int config_devices(const struct device *button, const struct device *led)
{
	int ret; 
	ret = gpio_pin_configure(led, PIN, GPIO_OUTPUT_ACTIVE | FLAGS);
	ret |= gpio_pin_configure(button, SW0_GPIO_PIN, SW0_GPIO_FLAGS);

	if (ret)
		return -1;

	if (gpio_pin_interrupt_configure(button,SW0_GPIO_PIN,GPIO_INT_EDGE_TO_ACTIVE))
		return -1;
	
	gpio_init_callback(&button_cb_data, button_pressed, BIT(SW0_GPIO_PIN));
	gpio_add_callback(button, &button_cb_data);

	btn_flag = false; 

	return 0; 
}

void button_pressed(const struct device *dev, struct gpio_callback *cb,
		    uint32_t pins)
{
	printk("Button pressed at %" PRIu32 "\n", k_cycle_get_32());
	btn_flag = true;
}
```

## src/main.h
```c
#ifndef MAIN_H
#define MAIN_H

#include <zephyr.h>
#include <sys/printk.h>
#include <sys/util.h>
#include <device.h>
#include <devicetree.h>
#include <drivers/gpio.h>
#include <drivers/flash.h>
#include <inttypes.h>
#include <storage/flash_map.h>
#include <stdio.h>
#include <dfu/mcuboot.h>
#include <power/reboot.h>
#include "detools/detools.h"

/* IMAGE OFFSETS AND SIZES */
#define PRIMARY_OFFSET FLASH_AREA_OFFSET(image_0)
#define PRIMARY_SIZE FLASH_AREA_SIZE(image_0)
#define SECONDARY_OFFSET FLASH_AREA_OFFSET(image_1)
#define SECONDARY_SIZE FLASH_AREA_SIZE(image_1)
#define STORAGE_OFFSET FLASH_AREA_OFFSET(storage)
#define STORAGE_SIZE FLASH_AREA_SIZE(storage)

/* PATCH HEADER SIZE */
#define HEADER_SIZE 0x18

/* FLASH MEMORY AND POINTERS TO CURRENT LOCATION OF BUFFERS AND END OF IMAGE AREAS.
 * - "Patch" refers to the area containing the patch image. 
 * - "From" refers to the area containing the source image. 
 * - "To" refers to the area where the target image is to be placed.
 * */
struct flash_mem {
	const struct device *device;
	off_t patch_current; 
	off_t patch_end; 
	off_t from_current; 
	off_t from_end; 
	off_t to_current; 
	off_t to_end; 
};

/* BUTTON */
#define SW0_NODE	DT_ALIAS(sw0)

#if DT_NODE_HAS_STATUS(SW0_NODE, okay)
#define SW0_GPIO_LABEL	DT_GPIO_LABEL(SW0_NODE, gpios)
#define SW0_GPIO_PIN	DT_GPIO_PIN(SW0_NODE, gpios)
#define SW0_GPIO_FLAGS	(GPIO_INPUT | DT_GPIO_FLAGS(SW0_NODE, gpios))
#else
#error "Unsupported board: sw0 devicetree alias is not defined"
#define SW0_GPIO_LABEL	""
#define SW0_GPIO_PIN	0
#define SW0_GPIO_FLAGS	0
#endif

static struct gpio_callback button_cb_data;
static bool btn_flag;

/* LED */
#define SLEEP_TIME_MS   1000 //BLINKING SPEED

#define LED0_NODE DT_ALIAS(led0)
#if DT_NODE_HAS_STATUS(LED0_NODE, okay)
#define LED0	DT_GPIO_LABEL(LED0_NODE, gpios)
#define PIN	DT_GPIO_PIN(LED0_NODE, gpios)
#define FLAGS	DT_GPIO_FLAGS(LED0_NODE, gpios)
#else
/* A build error here means your board isn't set up to blink an LED. */
#error "Unsupported board: led0 devicetree alias is not defined"
#define LED0	""
#define PIN	0
#define FLAGS	0
#endif

/* FUNCTION DECLARATIONS */

/**
 * Functiong for initiating the devices used by the 
 * program. 
 *
 * @param[in] flash the flash memory. 
 * @param[in] button the button.
 * @param[in] led the led.
 *
 * @return zero(0) or error code.
 */
static int configure_devices(const struct device *flash, 
					const struct device *button, 
					const struct device *led);

/**
 * Functiong for writing to secondary partition.
 *
 * @param[in] arg_p pointer to the devices flash memory. 
 * @param[in] buf_p buffer containing information to be written.
 * @param[in] size size of the buffer.
 *
 * @return zero(0) or error code.
 */
static int du_flash_write(void *arg_p,
					const uint8_t *buf_p,
					size_t size);

/**
 * Functiong for reading from primary partition.
 *
 * @param[in] arg_p pointer to the devices flash memory. 
 * @param[in] buf_p buffer to be read into.
 * @param[in] size size of the buffer.
 *
 * @return zero(0) or error code.
 */
static int du_flash_from_read(void *arg_p,
					uint8_t *buf_p,
					size_t size);

/**
 * Functiong for reading from patch partition.
 *
 * @param[in] arg_p pointer to the devices flash memory. 
 * @param[in] buf_p buffer to be read into.
 * @param[in] size size of the buffer.
 *
 * @return zero(0) or error code.
 */
static int du_flash_patch_read(void *arg_p,
					uint8_t *buf_p,
					size_t size);

/**
 * Functiong for jumping on the primary partition
 *
 * @param[in] arg_p pointer to the devices flash memory. 
 * @param[in] offset the size of the jump forward in bytes.
 *
 * @return zero(0) or error code.
 */
static int du_flash_seek(void *arg_p,
					int offset);

/**
 * Functiong for erasing data on the entire secondary partiton.
 *
 * @param[in] flash the devices flash memory. 
 *
 * @return zero(0) or error code.
 */
static int erase_secondary(const struct device *flash);

/**
 * Functiong initiating the flash_mem struct by setting
 * all offsets to their correct adresses.
 *
 * @param[in] flash the devices flash memory. 
 *
 * @return zero(0) or error code.
 */
static int init_flash_mem(struct flash_mem *flash);

/**
 * Functiong for reading the metadata from the patch and 
 * changing the header to mark that the patch has been 
 * applied.
 *
 * @param[in] flash the devices flash memory. 
 *
 * @return zero(0) or error code.
 */
static int read_patch_header(struct flash_mem *flash);

//Responds to button 1 being pressed 
void button_pressed(const struct device *dev, 
					struct gpio_callback *cb,
		    		uint32_t pins);

#endif
```

## src/test1.c
```c
/*
 * Copyright (c) 2016 Intel Corporation
 *
 * SPDX-License-Identifier: Apache-2.0
 */

#include <zephyr.h>
#include <device.h>
#include <devicetree.h>
#include <drivers/gpio.h>

/* 1000 msec = 1 sec */
#define SLEEP_TIME_MS   1000

/* The devicetree node identifier for the "led0" alias. */
#define LED0_NODE DT_ALIAS(led0)

#if DT_NODE_HAS_STATUS(LED0_NODE, okay)
#define LED0	DT_GPIO_LABEL(LED0_NODE, gpios)
#define PIN	DT_GPIO_PIN(LED0_NODE, gpios)
#define FLAGS	DT_GPIO_FLAGS(LED0_NODE, gpios)
#else
/* A build error here means your board isn't set up to blink an LED. */
#error "Unsupported board: led0 devicetree alias is not defined"
#define LED0	""
#define PIN	0
#define FLAGS	0
#endif

void main(void)
{
	struct device *dev;
	bool led_is_on = true;
	int ret;

	dev = device_get_binding(LED0);
	if (dev == NULL) {
		return;
	}

	ret = gpio_pin_configure(dev, PIN, GPIO_OUTPUT_ACTIVE | FLAGS);
	if (ret < 0) {
		return;
	}

	while (1) {
		gpio_pin_set(dev, PIN, (int)led_is_on);
		led_is_on = !led_is_on;
		k_msleep(SLEEP_TIME_MS);
	}
}
```
